/ {
    // Camada principal: pt-br internacional
    default_layer {
        bindings = <
        &kp TAB    &kp Q     &kp W     &kp E       &kp R     &kp T        &kp Y    &kp U     &kp I     &kp O      &kp P     &kp BSPC
        &kp LCTRL  &kp A     &kp S     &kp D       &kp F     &kp G        &kp H    &kp J     &kp K     &kp L      &kp SQT   &kp CEDILLA
        &kp LSHFT  &kp Z     &kp X     &kp C       &kp V     &kp B        &kp N    &kp M     &kp COMMA &kp DOT    &kp SLASH &kp ESC
                              &kp LGUI &mo 1       &kp SPACE &kp RET      &mo 2     &kp RALT
        >;
    };

    // Camada Lower: números e navegação
    lower_layer {
        bindings = <
        &kp GRAVE  &kp N1    &kp N2    &kp N3      &kp N4    &kp N5       &kp N6   &kp N7    &kp N8    &kp N9     &kp N0    &kp BSPC
        &trans     &bt BT0   &bt BT1   &bt BT2     &bt BT3   &bt BT4      &kp LEFT &kp DOWN &kp UP    &kp RIGHT  &trans    &trans
        &trans     &trans    &trans    &trans      &trans    &trans       &trans   &trans   &trans    &trans     &bootloader &bt BT_CLR_ALL
                               &trans  &trans      &trans    &trans       &trans    &trans
        >;
    };

    // Camada Raise: símbolos e acentos
    raise_layer {
        bindings = <
        &kp ESC    &kp EXCL  &kp AT    &kp HASH    &kp DLLR  &kp PRCNT     &kp CARET &kp AMPS   &kp ASTRK  &kp LPAR   &kp RPAR   &kp BSPC
        &trans     &kp ACUTE &kp GRAVE &kp TILDE   &kp CIRC  &trans        &kp MINUS &kp EQUAL  &kp LBKT   &kp RBKT   &kp BSLH   &kp PIPE
        &trans     &trans    &trans    &trans      &trans    &trans        &kp UNDER &kp PLUS   &kp LBRC   &kp RBRC   &kp DQT    &bt BT_CLR
                               &trans  &trans      &kp SPACE &kp RET       &trans    &kp RALT
        >;
    };
};
